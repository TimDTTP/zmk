## config/west.yml
```yaml
manifest:
  remotes:
    - name: zmkfirmware
      url-base: https://github.com/zmkfirmware
    - name: infely # custom nano view
      url-base: https://github.com/infely # custom nano view
    - name: urob # helper for better hm
      url-base: https://github.com/urob # helper for better hm
  projects:
    - name: zmk
      remote: zmkfirmware
      revision: main
      import: app/west.yml
    - name: nice-view-battery # custom nano view
      remote: infely # custom nano view
      revision: main # custom nano view
    - name: zmk-helpers # helper for better hm
      remote: urob # helper for better hm
      revision: main # helper for better hm
  self:
    path: config
```
